// SPDX-License-Identifier: GPL-2.0+

#include "aspeed-g6.dtsi"

/ {

       i2carb: i2carb {
               compatible = "i2c-arb-gpio-challenge";
               #address-cells = <1>;
               #size-cells = <0>;
               status = "disabled";
       };
};
