## meta-ast2600/conf/machine/include/obmc-bsp-si-common.inc
```bitbake
#@TYPE: Machine
#@NAME: OpenBMC
#@DESCRIPTION: Common machine configuration for OpenBMC chips

MACHINE_EXTRA_RRECOMMENDS = " kernel-modules"
EXTRA_IMAGEDEPENDS += "u-boot"

IMAGE_FSTYPES += "squashfs-xz"
IMAGE_FSTYPES += "mtd-auto"
INITRAMFS_FSTYPES = "squashfs-xz"
# FIXME: There is an issue in Yocto where the command-specific EXTRA_IMAGECMD
# doesn't work anymore, so as a temporary workaround to unblock the upstream
# sync, this removes the 'squashfs-xz' and makes the parameters generic. This
# seems to work because we don't have any other IMAGE_CMD commands that we use.
# But it could cause issues if we ever need to use another IMAGE_CMD, so we
# should correct this as soon as possible after we get a fix from Yocto.
EXTRA_IMAGECMD:append = "-processors ${BB_NUMBER_THREADS} -b 262144 -Xdict-size 100% -Xbcj arm"
#This is the original line for reference
#EXTRA_IMAGECMD:squashfs-xz:append = "-processors ${BB_NUMBER_THREADS} -b 262144 -Xdict-size 100% -Xbcj arm"

KERNEL_CLASSES ?= "kernel-fitimage"
KERNEL_IMAGETYPES ?= "fitImage"
KERNEL_EXTRA_ARGS += "LOADADDR=${UBOOT_ENTRYPOINT}"

UBOOT_SUFFIX ?= "bin"

MACHINEOVERRIDES =. "openbmc:"

OBMC_PHOSPHOR_IMAGE_OVERLAY= "1"
OBMC_IMAGE_EXTRA_INSTALL:append = "u-boot-fw-utils-aspeed-sdk"

IMAGE_CLASSES += "image_types image_types_phosphor_auto qemuboot"

# do not generate an initramfs; use the above squashfs-xz as an initrd instead
INITRAMFS_FSTYPES = ""
INITRAMFS_CTYPE = ""
INITRAMFS_IMAGE = ""

MACHINE_FEATURES_BACKFILL_CONSIDERED = "qemu-usermode"

KERNEL_IMAGETYPES += "zImage"

# runqemu
QB_SYSTEM_NAME = "qemu-system-arm"
QB_DEFAULT_FSTYPE = "mtd"
QB_ROOTFS_OPT = "-drive file=@ROOTFS@,format=raw,if=mtd"
QB_MACHINE = "-M intel-ast2600"
QB_OPT_APPEND += " -nographic -serial mon:stdio -serial none"
QB_OPT_APPEND += " -global driver=aspeed.gpio-ast2600,property=gpioC0,value=true"
QB_NETWORK_DEVICE = "-net nic,macaddr=C0:FF:EE:00:00:02,model=ftgmac100"
QB_DEFAULT_KERNEL = "none"
QB_RNG = ""
QB_MEM = "1024"
```

## meta-evb/meta-evb-aspeed/meta-evb-ast2600/conf/machine/evb-ast2600.conf
```bitbake
KERNEL_DEVICETREE = "aspeed-ast2600-evb.dtb"

UBOOT_MACHINE = "ast2600_openbmc_defconfig"
UBOOT_DEVICETREE = "ast2600-evb"
SPL_BINARY = "spl/u-boot-spl.bin"
# Disable hardware root of trust by default.
# If users want to enable secure boot,
# please do the following steps.
# 1. Set SOCSEC_SIGN_ENABLE to “1”.
# 2. Provide platform OTP config.
# There was an example in p10bmc.
# If users enable socsec signing but do not provide OTP config,
# u-boot will be built failed.
SOCSEC_SIGN_ENABLE = "0"

KMACHINE = "aspeed"

require conf/machine/include/obmc-evb-common.inc
require conf/machine/include/ast2600.inc
#require conf/machine/include/intel.inc

#TARGET_FPU = "hard"

MACHINE_FEATURES += "obmc-host-ipmi"

PREFERRED_PROVIDER_u-boot-fw-utils ?= "u-boot-fw-utils-aspeed-sdk"
PREFERRED_PROVIDER_virtual/kernel = "linux-aspeed"
PREFERRED_PROVIDER_virtual/obmc-host-ipmi-hw = "phosphor-ipmi-kcs"

SERIAL_CONSOLES = "115200;ttyS4"

# AST2600 EVB has 64MB SPI flash
FLASH_SIZE = "65536"
```

## meta-evb/meta-evb-aspeed/meta-evb-ast2700/conf/machine/include/ast-optee-os.inc
```bitbake
MACHINE_FEATURES:append = " ast-optee-os"
MACHINEOVERRIDES .= ":ast-optee-os"
UBOOT_FIT_TEE = "1"
```

## meta-evb/meta-evb-aspeed/meta-evb-ast2700/conf/machine/include/ast-tsp.inc
```bitbake
MACHINE_FEATURES:append = " ast-tsp"
MACHINEOVERRIDES .= ":ast-tsp"
UBOOT_FIT_USER_IMAGE = "1"
UBOOT_FIT_TSP = "1"
UBOOT_FIT_CONF_USER_LOADABLES:append = ' ,\"tspfw\"'
```

## meta-evb/meta-evb-aspeed/meta-evb-ast2700/conf/machine/include/ast2700-sdk.inc
```bitbake
SOC_FAMILY = "aspeed-g7"
include conf/machine/include/soc-family.inc
require conf/machine/include/aspeed-sdk.inc

DEFAULTTUNE = "cortexa35"

require conf/machine/include/arm/armv8a/tune-cortexa35.inc
require conf/machine/include/ast-arm-trusted-firmware-a.inc
require conf/machine/include/ast-bootmcu.inc

SERIAL_CONSOLES ?= "115200;ttyS12"

# bootloader fitimage
UBOOT_FIT_UBOOT_ENTRYPOINT ?= "0x80000000"
UBOOT_FIT_UBOOT_LOADADDRESS ?= "0x80000000"
UBOOT_FIT_ARM_TRUSTED_FIRMWARE_A_LOADADDRESS ?= "0xb0000000"
UBOOT_FIT_ARM_TRUSTED_FIRMWARE_A_ENTRYPOINT ?= "0xb0000000"
UBOOT_FIT_OPTEE_OS_LOADADDRESS ?= "0xb0080000"
UBOOT_FIT_OPTEE_OS_ENTRYPOINT ?= "0xb0080000"

# kernel fitimage
FIT_ADDRESS_CELLS ?= "2"
UBOOT_ENTRYPOINT ?= "0x4 0x00000000"
UBOOT_LOADADDRESS ?= "0x4 0x00000000"

COMPATIBLE_MACHINE:aspeed-g7 = "aspeed-g7"
TFA_PLATFORM = "ast2700"

# optee for BL32.
TFA_SPD = "opteed"

# TFA default build is BL31.
TFA_BUILD_TARGET = "bl31"

# It is a shortcut for "make PLATFORM=aspeed PLATFORM_FLAVOR=ast2700"
OPTEEMACHINE = "aspeed-ast2700"

UBOOT_FIT_ARM_TRUSTED_FIRMWARE_A_IMAGE ?= "${DEPLOY_DIR_IMAGE}/${TFA_BUILD_TARGET}.bin"
UBOOT_FIT_OPTEE_OS_IMAGE ?= "${DEPLOY_DIR_IMAGE}/optee/tee-raw.bin"
```

## meta-evb/meta-evb-aspeed/meta-evb-ast2700/conf/machine/include/cypress-s25hx.inc
```bitbake
# Support Cypress S25Hx 2-bit ECC mode.

MACHINE_FEATURES:append = " cypress-s25hx "
MACHINEOVERRIDES .= ":cypress-s25hx"
```

## meta-evb/meta-evb-aspeed/meta-evb-ast2700/conf/machine/include/static-rwfs.inc
```bitbake
MACHINE_FEATURES:append = " static-rwfs-jffs2 "
MACHINEOVERRIDES .= ":static-rwfs-jffs2"
```

## meta-evb/meta-evb-aspeed/meta-evb-ast2700/meta-aspeed-pfr/conf/machine/include/cerberus-pfr.inc
```bitbake
# Support Cerberus PFR mode.

MACHINE_FEATURES:append = " cerberus-pfr "
MACHINEOVERRIDES .= ":cerberus-pfr"
```

## meta-evb/meta-evb-aspeed/meta-evb-ast2700/meta-aspeed-pfr/conf/machine/include/intel-pfr.inc
```bitbake
# Support Intel PFR mode.

MACHINE_FEATURES:append = " intel-pfr "
MACHINEOVERRIDES .= ":intel-pfr"
```

## meta-evb/meta-evb-aspeed/meta-evb-ast2700/meta-ast2700-pfr/conf/machine/ast2700-a0-dcscm-ast1700-demo.conf
```bitbake
require conf/machine/ast2700-a0-dcscm.conf

# Kernel Build Settings
KERNEL_DEVICETREE = "aspeed/ast2700a0-dcscm_ast1700a0-demo.dtb"
```

## meta-evb/meta-evb-aspeed/meta-evb-ast2700/meta-ast2700-pfr/conf/machine/ast2700-dcscm-ast1700-evb.conf
```bitbake
require conf/machine/ast2700-dcscm.conf

# Kernel Build Settings
KERNEL_DEVICETREE = "aspeed/ast2700-dcscm_ast1700-evb.dtb"
```

## meta-evb/meta-evb-aspeed/meta-evb-ast2700/meta-ast2700/conf/machine/ast2700-a0-default-ncsi.conf
```bitbake
require conf/machine/ast2700-a0-default.conf

# U-Boot Build Settings
UBOOT_DEVICETREE = "ast2700-ncsi"

# Kernel Build Settings
KERNEL_DEVICETREE = "aspeed/ast2700a0-ncsi.dtb"
```

## meta-evb/meta-evb-nuvoton/meta-evb-npcm845/recipes-kernel/linux/linux-onetree/i3c-arbel-npcm845/drivers/i3c/Kconfig
```kconfig
# SPDX-License-Identifier: GPL-2.0

menuconfig I3C
	tristate "I3C support"
	select I2C
	help
	  I3C is a serial protocol standardized by the MIPI alliance.

	  It's supposed to be backward compatible with I2C while providing
	  support for high speed transfers and native interrupt support
	  without the need for extra pins.

	  The I3C protocol also standardizes the slave device types and is
	  mainly designed to communicate with sensors.

	  If you want I3C support, you should say Y here and also to the
	  specific driver for your bus adapter(s) below.

	  This I3C support can also be built as a module.  If so, the module
	  will be called i3c.

if I3C

source "drivers/i3c/mctp/Kconfig"

config I3CDEV
	tristate "I3C device interface"
	depends on I3C
	help
	  Say Y here to use i3c-* device files, usually found in the /dev
	  directory on your system.  They make it possible to have user-space
	  programs use the I3C devices.

	  This support is also available as a module.  If so, the module
	  will be called i3cdev.

	  Note that this application programming interface is EXPERIMENTAL
	  and hence SUBJECT TO CHANGE WITHOUT NOTICE while it stabilizes.

config I3C_HUB
	tristate "I3C HUB support"
	depends on I3C
	select REGMAP_I3C
	help
	  This enables support for I3C HUB. Say Y here to use I3C HUB driver to
	  configure I3C HUB device.

config I3C_NPCM_BIC
	bool "NPCM Bridge IC support"
	default y
	help
	  Say Y here to enable NPCM Bridge IC device driver.

source "drivers/i3c/master/Kconfig"
endif # I3C
```
