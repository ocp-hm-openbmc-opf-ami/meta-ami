/dts-v1/;
/plugin/;

/* Mux pin221 (GPIO221/SMB12_SDA/PWM9) to PWM9, and pin76 (GPIO76/FANIN12)
 * to FANIN12 so tach channel 0x0C is exposed as hwmon fan13_input.
 * fdtoverlay replaces the whole property, so the base &pwm_fan pinctrl-0
 * list is restated here with &pwm8_pins and &fanin12_pins added. Labels
 * resolve via the base dtb __symbols__ (built with DTC_FLAGS=-@).
 */
&pwm_fan {
	pinctrl-0 = <&pwm0_pins &pwm1_pins
		&pwm2_pins &pwm3_pins
		&pwm4_pins &pwm5_pins
		&pwm6_pins &pwm7_pins
		&pwm8_pins
		&fanin0_pins &fanin1_pins
		&fanin2_pins &fanin3_pins
		&fanin4_pins &fanin5_pins
		&fanin6_pins &fanin7_pins
		&fanin12_pins>;

	/* Expose PWM9 (channel index 8). Driver exports pwm9_input when reg=0x08 exists. */
	fan@8 {
		reg = <0x08>;
		fan-tach-ch = /bits/ 8 <0x0C>;
		cooling-levels = /bits/ 8 <127 255>;
	};
};
