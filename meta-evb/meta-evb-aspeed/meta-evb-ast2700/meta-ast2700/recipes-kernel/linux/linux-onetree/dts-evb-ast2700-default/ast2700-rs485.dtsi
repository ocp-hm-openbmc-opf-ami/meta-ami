// SPDX-License-Identifier: GPL-2.0-or-later
//
// RS-485 (em485 software direction control) for Aspeed AST2700 UARTs.
//
// HOW THIS IS ENABLED
//   Enabled via MACHINE_FEATURES += "onetree-rs485" (set family-wide for AST2700
//   in meta-evb-ast2700/conf/layer.conf). That both selects the kernel capability
//   CONFIG_SERIAL_8250_ASPEED_RS485=y (rs485.cfg) and #include's this file into
//   ast2700-evb.dts.
//
// PIN VALUES ARE PLACEHOLDERS (IMPORTANT)
//   The rts-gpios below (GPIOD0/D4) are reference values carried over with the
//   RS-485 fix; the AST2700 EVB has no RS-485 transceiver, so they are inert
//   there. Before using RS-485 on a wired AST2700, set each node from the
//   board schematic:
//     1. Keep ONLY the &uartN nodes that are wired to an RS-485 transceiver;
//        delete the rest. (uartN must also be status = "okay" in the base dts.)
//     2. Set rts-gpios to the GPIO that drives that transceiver's DE/RE pin:
//          rts-gpios = <&gpioX <line> GPIO_ACTIVE_HIGH>;
//        Use GPIO_ACTIVE_LOW if the transceiver enable is active-low.
//        (&gpio1 is the main BMC GPIO controller; bank D line 4 = 24+4 = 28.)
//     3. rs485-rts-delay = <before_us after_us> — DIR assert/de-assert guard
//        times; <0 0> is fine for most transceivers.
//     4. Drop rs485-rx-during-tx if your bus must not echo TX back to RX.
//
// em485 stays inactive on a UART until its node below has rts-gpios +
// linux,rs485-enabled-at-boot-time, so unwired UARTs are unaffected.

#include <dt-bindings/gpio/gpio.h>

&uart0 {
	rts-gpios = <&gpio1 28 GPIO_ACTIVE_HIGH>;   /* GPIOD4 = UART0_DIR */
	linux,rs485-enabled-at-boot-time;
	rs485-rts-delay = <0 0>;
	rs485-rx-during-tx;
};

&uart2 {
	rts-gpios = <&gpio1 24 GPIO_ACTIVE_HIGH>;   /* GPIOD0 = UART2_DIR */
	linux,rs485-enabled-at-boot-time;
	rs485-rts-delay = <0 0>;
	rs485-rx-during-tx;
};
