// SPDX-License-Identifier: GPL-2.0-or-later
// Copyright 2019 IBM Corp.

&mdio1 {
	status = "okay";
	#address-cells = <1>;
	#size-cells = <0>;

	ethphy1: ethernet-phy@0 {
		compatible = "ethernet-phy-ieee802.3-c22";
		reg = <0>;
	};
};