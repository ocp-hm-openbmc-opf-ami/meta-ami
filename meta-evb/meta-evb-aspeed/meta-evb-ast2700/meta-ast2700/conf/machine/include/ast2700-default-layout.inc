## meta-evb/meta-evb-aspeed/meta-evb-ast2700/meta-ast2700/conf/machine/include/ast2700-default-layout.inc
```bitbake
#flash-size
FLASH_SIZE = "131072"

#SectionName: "u-boot"
FLASH_UBOOT_OFFSET:flash-131072 = "0" 
FLASH_UBOOT_SIZE:flash-131072 = "4096"

#SectionName: "u-boot-env"
FLASH_UBOOT_ENV_OFFSET:flash-131072 = "4096" 
FLASH_UBOOT_ENV_SIZE:flash-131072 = "128"

#SectionName: "kernel"
FLASH_KERNEL_OFFSET:flash-131072 = "4224" 
FLASH_KERNEL_SIZE:flash-131072 = "11264"

#SectionName: "rofs"
FLASH_ROFS_OFFSET:flash-131072 = "15488" 
FLASH_ROFS_SIZE:flash-131072 = "84864"

#SectionName: "rwfs"
FLASH_RWFS_OFFSET:flash-131072 = "100352" 
FLASH_RWFS_SIZE:flash-131072 = "30656"

#SectionName: "reserved"
FLASH_RESERVED_OFFSET:flash-131072 = "131008"
FLASH_RESERVED_SIZE:flash-131072 = "64"
```

## meta-evb/meta-evb-nuvoton/conf/layer.conf
```bitbake
# We have a conf and classes directory, add to BBPATH
BBPATH .= ":${LAYERDIR}"

BBFILES += "${LAYERDIR}/recipes-*/*/*.bb \
            ${LAYERDIR}/recipes-*/*/*.bbappend"

BBFILE_COLLECTIONS += "nuvoton"
BBFILE_PATTERN_nuvoton := "^${LAYERDIR}/"
LAYERVERSION_nuvoton = "1"
LAYERSERIES_COMPAT_nuvoton = "walnascar"
LAYERDEPENDS_nuvoton:append:npcm8xx = " meta-arm"
EXTRA_IMAGE_FEATURES:append = " onetree-media-redirect"
BBFILE_PRIORITY_nuvoton = "11"

ENABLE_BONDING = "network-bond"
```

## meta-evb/meta-evb-nuvoton/meta-evb-npcm845/conf/machine/include/evb-npcm845-layout.inc
```bitbake
# All sizes & offsets below are in KB

#flash-size
FLASH_SIZE = "65536"

#SectionName: "bmc"
FLASH_BMC_OFFSET:flash-65536 = "0"
FLASH_BMC_SIZE:flash-65536   = "65536"

#SectionName: "u-boot"
FLASH_UBOOT_OFFSET:flash-65536 = "0"
FLASH_UBOOT_SIZE:flash-65536   = "3840"

#SectionName: "u-boot-env"
FLASH_UBOOT_ENV_OFFSET:flash-65536 = "3840"
FLASH_UBOOT_ENV_SIZE:flash-65536   = "256"

#SectionName: "kernel"
FLASH_KERNEL_OFFSET:flash-65536 = "4096"
FLASH_KERNEL_SIZE:flash-65536   = "9472"

#SectionName: "rofs"
FLASH_ROFS_OFFSET:flash-65536 = "13568"
FLASH_ROFS_SIZE:flash-65536   = "48896"

#SectionName: "rwfs"
FLASH_RWFS_OFFSET:flash-65536 = "62464"
FLASH_RWFS_SIZE:flash-65536   = "3008"

#SectionName: "reserved"
FLASH_RESERVED_OFFSET:flash-65536 = "65472"
FLASH_RESERVED_SIZE:flash-65536   = "64"
```

## meta-evb/meta-evb-nxp/conf/machine/include/imx91.inc
```bitbake
# Copyright 2025-2026 NXP

KSOC = "imx91"
KBOARD = "frdm"
KPKG = "11x11"
# KMACHINE = "${KSOC}-${KBOARD}"
CONFIG_BASENAME = "${KSOC}_${KPKG}_${KBOARD}"

BMC_LINUX_DTS = "${KSOC}-${KPKG}-${KBOARD}.dtb"

include conf/machine/include/nxp.inc
include conf/machine/imx91frdm.conf
```

## meta-evb/meta-evb-nxp/conf/machine/include/imx93.inc
```bitbake
# Copyright 2025-2026 NXP

KSOC = "imx93"
KBOARD = "frdm"
KPKG = "11x11"
# KMACHINE = "${KSOC}-${KBOARD}"
CONFIG_BASENAME = "${KSOC}_${KPKG}_${KBOARD}"

BMC_LINUX_DTS = "${KSOC}-${KPKG}-${KBOARD}.dtb"
BMC_LINUX_DEFCONFIG = "imx_openbmc_defconfig"

include conf/machine/include/nxp.inc
include conf/machine/imx93frdm.conf
#include conf/machine/imx93evk.conf
```

## meta-evb/meta-evb-nxp/conf/machine/include/imx943.inc
```bitbake
# Copyright 2025-2026 NXP

KSOC = "imx943"
KBOARD = "evk"
# KMACHINE = "${KSOC}-${KBOARD}"
CONFIG_BASENAME = "${KSOC}_${KBOARD}"

BMC_LINUX_DTS = "${KSOC}-evk.dtb"

include conf/machine/include/nxp.inc
include conf/machine/imx943evk.conf
```

## meta-evb/meta-evb-nxp/conf/machine/include/imx95.inc
```bitbake
# Copyright 2025-2026 NXP


KSOC = "imx95"
KBOARD = "evk"
KPKG = "19x19"
# KMACHINE = "${KSOC}-${KBOARD}"
CONFIG_BASENAME = "${KSOC}_${KPKG}_${KBOARD}"

#BMC_LINUX_DTS = "${KSOC}-${KPKG}-${KBOARD}.dtb"
BMC_LINUX_DTS = "imx95-19x19-evk-ep-adv7535.dtb"

include conf/machine/include/nxp.inc
#include conf/machine/imx95-15x15-lpddr4x-frdm.conf
include conf/machine/imx95-19x19-lpddr5-evk.conf
```

## meta-evb/meta-evb-nxp/conf/machine/include/nxp.inc
```bitbake
# Copyright 2025-2026 NXP

require conf/machine/include/arm/armv8-2a/tune-cortexa55.inc

PREFERRED_PROVIDER_virtual/kernel ??= "linux-nxp"
PREFERRED_PROVIDER_virtual/xserver ?= "xserver-xorg"

PREFERRED_PROVIDER_virtual/libomxil ?= "userland"
VIRTUAL-RUNTIME_libomxil = "userland"

#PREFERRED_VERSION_linux-imx ??= "6.12.%"

IMAGE_FSTYPES ?= "tar.bz2 ext3 cpio.gz wic.bz2 wic.bmap"

MACHINEOVERRIDES .= ":nxp"

XSERVER = " \
    xserver-xorg \
    ${@bb.utils.contains("MACHINE_FEATURES", "vc4graphics", "xserver-xorg-extension-glx", "", d)} \
    ${@bb.utils.contains("MACHINE_FEATURES", "vc4graphics", "xf86-video-modesetting", "xf86-video-fbdev", d)} \
    "

RPI_KERNEL_DEVICETREE_OVERLAYS ?= " \
    freescale/${REAL_TIME_EDGE_LINUX_DTS} \
    "

RPI_KERNEL_DEVICETREE ?= " \
    ${REAL_TIME_EDGE_LINUX_DTS} \
    "

KERNEL_DEVICETREE ??= " \
    ${RPI_KERNEL_DEVICETREE_OVERLAYS} \
    "

BMC_LINUX_SRC_INTERNAL = "git://git@bitbucket.sw.nxp.com/lfac/linux-lts-nxp.git;protocol=ssh"
BMC_LINUX_SRC_GITHUB = "git://github.com/nxp-imx/linux-imx.git;protocol=https"

BMC_LINUX_SRC = "${BMC_LINUX_SRC_GITHUB}"
BMC_LINUX_BRANCH = "lf-6.12.y"
BMC_LINUX_SRCREV = "df24f9428e38740256a410b983003a478e72a7c0"
BMC_LINUX_DEFCONFIG ?= "imx_v8_defconfig"

KERNEL_BOOTCMD ??= "bootm"
KERNEL_IMAGETYPE_UBOOT ??= "uImage"
KERNEL_IMAGETYPE_DIRECT ??= "Image"
KERNEL_IMAGETYPE ?= "${@bb.utils.contains('RPI_USE_U_BOOT', '1', \
        '${KERNEL_IMAGETYPE_UBOOT}', '${KERNEL_IMAGETYPE_DIRECT}', d)}"

MACHINE_FEATURES += "apm usbhost keyboard vfat ext2 screen touchscreen alsa bluetooth wifi sdio ${@bb.utils.contains('DISABLE_VC4GRAPHICS', '1', '', 'vc4graphics', d)}"

MACHINE_FEATURES_BACKFILL_CONSIDERED = "rtc"

MACHINE_EXTRA_RRECOMMENDS += "kernel-modules udev-rules-imx"
MACHINE_ESSENTIAL_EXTRA_RRECOMMENDS += "${@oe.utils.conditional('ENABLE_I2C', '1', 'kernel-module-i2c-dev kernel-module-i2c-bcm2708', '', d)}"
MACHINE_ESSENTIAL_EXTRA_RRECOMMENDS += "${@oe.utils.conditional('ENABLE_IR', '1', 'kernel-module-gpio-ir kernel-module-gpio-ir-tx', '', d)}"
MACHINE_ESSENTIAL_EXTRA_RRECOMMENDS += "${@oe.utils.conditional('ENABLE_GPIO_SHUTDOWN', '1', 'gpio-shutdown kernel-module-gpio-keys', '', d)}"

SERIAL_CONSOLES_CHECK ??= "${SERIAL_CONSOLES}"

BOOTFILES_DIR_NAME ?= "bootfiles"

def make_dtb_boot_files(d):
    # KERNEL_DEVICETREE.
    alldtbs = d.getVar('KERNEL_DEVICETREE')

    def transform(dtb):
        base = os.path.basename(dtb)
        if dtb.endswith('dtbo') or base == '${KERNEL_DEVICETREE}':
            return '{};{}'.format(base, dtb)
        elif dtb.endswith('dtb'):
            return base

    return ' '.join([transform(dtb) for dtb in alldtbs.split(' ') if dtb])
```

## meta-evb/meta-evb-nxp/meta-imx93/conf/machine/evb-imx93.conf
```bitbake
#@TYPE: Machine
#@NAME: imx93 Development Board (64bit)
#@DESCRIPTION: Machine configuration for the imx93 in 64 bits mode

DEFAULTTUNE = "cortexa55"

include conf/machine/include/imx93.inc

MACHINE_FEATURES:remove = "nxpiw612-sdio"
MACHINE_EXTRA_RRECOMMENDS:remove = " \
    firmware-nxp-wifi-nxpiw612-sdio \
    imx-m33-demos \
    kernel-module-nxp-wlan \
"

KERNEL_DEVICETREE = "freescale/imx93-11x11-frdm-bmc.dtb"

SERIAL_CONSOLES ?= "115200;ttyLP0"
SYSTEMD_AUTO_ENABLE = "enable"
IMAGE_INSTALL:append = " libmctp mctp"
AMI_CORE_FEATURES:remove = "onetree-kvm"

FLASH_SIZE = "65536"

WKS_FILE = "obmc-phosphor-image.evb-${KSOC}.wks"

ATF_PLATFORM = "${KSOC}"

UBOOT_CONFIG_BASENAME = "${CONFIG_BASENAME}"
UBOOT_DTB_NAME = "imx93-11x11-frdm-bmc.dtb"
UBOOT_CONFIG = "sd emmc fspi qspi"
UBOOT_CONFIG[sd] = "${UBOOT_CONFIG_BASENAME}_defconfig,sdcard"
UBOOT_CONFIG[emmc] = "${UBOOT_CONFIG_BASENAME}_defconfig"
UBOOT_CONFIG[fspi] = "${UBOOT_CONFIG_BASENAME}_defconfig"
UBOOT_CONFIG[qspi] = "${UBOOT_CONFIG_BASENAME}_defconfig"
IMXBOOT_TARGETS[sd] = "flash_singleboot"
IMXBOOT_TARGETS[emmc] = "flash_singleboot"
IMXBOOT_TARGETS[fspi] = "flash_singleboot_flexspi"
IMXBOOT_TARGETS[qspi] = "flash_singleboot_flexspi"
IMAGE_BOOT_FILES = "u-boot.bin Image ${@' '.join([dtb.split('/')[-1] for dtb in d.getVar('KERNEL_DEVICETREE').split()])} tee.bin"
BOOTIMG_DIR = "${DEPLOY_DIR_IMAGE}"

# Let U-Boot provide a boot container (flash.bin) instead of imx-boot
UBOOT_PROVIDES_BOOT_CONTAINER = "1"

# In each NXP machine conf
MACHINEOVERRIDES =. "nxp:"

# "zImage" not supported on arm64 and ".gz" images not supported by bootloader yet
KERNEL_IMAGETYPE_DIRECT ?= "Image"
KERNEL_BOOTCMD ?= "booti"

ARMSTUB ?= "armstub8-gic.bin"

VIRTUAL-RUNTIME_obmc-gpio-monitor = "obmc-gpio-monitor"

PREFERRED_PROVIDER_virtual/phosphor-led-manager-config-native = "imx-led-manager-config-native"

# Select implementations for OpenBMC management virtuals
VIRTUAL-RUNTIME_obmc-system-mgmt  ?= "phosphor-state-manager"
VIRTUAL-RUNTIME_obmc-chassis-mgmt ?= "phosphor-state-manager"
VIRTUAL-RUNTIME_obmc-host-mgmt    ?= "phosphor-state-manager"

WKS_FILE_DEPENDS += "imx-boot"
```

## meta-evb/meta-evb-nxp/meta-imx95/recipes-itb/kernel-imx95/files/kernel-imx95-openbmc.its
```
/*
 * Copyright 2024-2026 NXP
 *
 * This file is licensed under the terms of the GNU General Public
 * License version 2.  This program is licensed "as is" without any
 * warranty of any kind, whether express or implied.
 */

/dts-v1/;

/ {
	description = "Image file for the imx8mp evb Linux Kernel";
	#address-cells = <1>;

	images {
                kernel {
                        description = "ARM64 Kernel";
                        data = /incbin/("kernel-image.gz");
                        type = "kernel";
                        arch = "arm64";
                        os = "linux";
                        compression = "gzip";
                        load = <0x80400000>;
                        entry = <0x80400000>;
                        hash-1 {
                                algo = "crc32";
                        };
                };

                initrd {
                        description = "initrd for arm64";
                        data = /incbin/("rootfs.cpio.gz");
                        type = "ramdisk";
                        arch = "arm64";
                        os = "linux";
                        compression = "none";
                        load = <0x83800000>;
                        entry = <0x83800000>;
                        hash-1 {
                                algo = "crc32";
                        };
                };

                fdt-dtb {
                        description = "nxp-dtb";
                        data = /incbin/("freescale.dtb");
                        type = "flat_dt";
                        arch = "arm64";
                        os = "linux";
                        compression = "none";
                        load = <0x83000000>;
                        hash-1 {
                                algo = "crc32";
                        };
                };

	};

	configurations {
		default = "config-1";
		config-1 {
			description = "Boot Linux kernel";
			kernel = "kernel";
			fdt = "fdt-dtb";
			ramdisk = "initrd";
		};
	};
};
```
