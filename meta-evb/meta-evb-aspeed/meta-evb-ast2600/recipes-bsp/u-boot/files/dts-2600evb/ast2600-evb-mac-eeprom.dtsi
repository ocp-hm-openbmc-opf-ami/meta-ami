// SPDX-License-Identifier: GPL-2.0+

&i2c7 {
	status = "okay";

	pinctrl-names = "default";
	pinctrl-0 = <&pinctrl_i2c8_default>;
	eeprom@50 {
		compatible = "atmel,24c08";
		reg = <0x50>;
		pagesize = <16>;
		offset_len = <1>;
		/*
		 * macoffsetN: specifies the byte offset inside this EEPROM where
		 * the MAC address for a specific network interface is stored.
		 *
		 * Each interface has its own property named macoffset<N>, where
		 * N maps to the interface index:
		 *   macoffset0 -> ethaddr   (eth0)
		 *   macoffset1 -> eth1addr  (eth1)
		 *   macoffset2 -> eth2addr  (eth2)
		 *   macoffset3 -> eth3addr  (eth3)
		 *   macoffset4 -> eth4addr  (eth4)
		 *   macoffset5 -> eth5addr  (eth5)
		 *
		 * Only specify properties for interfaces whose MAC address is
		 * stored in this EEPROM. Interfaces without a macoffsetN property
		 * are skipped automatically.
		 *
		 * Example: MAC for eth1addr stored at EEPROM offset 0xe1:
		 *
		 *   macoffset1 = <0xe1>;
		 *
		 * Each MAC address occupies 6 consecutive bytes at its offset.
		 */
		macoffset0 = <0x00>;
		macoffset1 = <0x06>;
		macoffset2 = <0x0c>;
		macoffset3 = <0x12>;
	};
};
