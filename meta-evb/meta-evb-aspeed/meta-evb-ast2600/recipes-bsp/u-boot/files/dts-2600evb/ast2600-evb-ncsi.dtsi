// SPDX-License-Identifier: GPL-2.0+

&mac2 {
	status = "disabled";
	phy-mode = "rgmii-id";
	phy-handle = <&ethphy2>;
	pinctrl-names = "default";
	pinctrl-0 = <&pinctrl_rgmii3_default>;

	rx-internal-delay-ps = <0>;
	tx-internal-delay-ps = <0>;
};

&mac3 {
	status = "okay";
	phy-mode = "NC-SI";
	use-ncsi;
	pinctrl-names = "default";
	pinctrl-0 = <&pinctrl_rmii4_default>;
	/delete-property/phy-handle;

	rx-internal-delay-ps = <0>;
	tx-internal-delay-ps = <0>;
};
