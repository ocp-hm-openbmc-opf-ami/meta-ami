## conf/layer.conf
```bitbake
# We have a conf and classes directory, add to BBPATH
BBPATH .= ":${LAYERDIR}"

# We have recipes-* directories, add to BBFILES
BBFILES += "${LAYERDIR}/recipes-*/*/*.bb \
            ${LAYERDIR}/recipes-*/*/*.bbappend \
            ${LAYERDIR}/recipes-*/*/*/*.bb \
            ${LAYERDIR}/recipes-*/*/*/*.bbappend \
            ${LAYERDIR}/recipes-*/*/*/*/*.bb \
            ${LAYERDIR}/recipes-*/*/*/*/*.bbappend \
            ${LAYERDIR}/meta-common/recipes-*/*/*.bb \
            ${LAYERDIR}/meta-common/recipes-*/*/*.bbappend \
           "

BBFILE_COLLECTIONS += "meta-ami"
BBFILE_PATTERN_meta-ami = "^${LAYERDIR}/"
BBFILE_PRIORITY_meta-ami = "14"

LAYERVERSION_meta-ami = "1"
LAYERSERIES_COMPAT_meta-ami = "walnascar"

AMIBASE = '${@os.path.normpath("${LAYERDIR}/")}'

IMAGE_INSTALL:append = " systemd-analyze "

IMAGE_INSTALL:append = " ${@bb.utils.contains('IMAGE_FEATURES', 'onetree-rtp', 'redfish-rde-dbus', '', d)}"
IMAGE_INSTALL:append = " ${@bb.utils.contains('IMAGE_FSTYPES', 'intel-pfr', '', 'ami-fw-update', d)}"
# TODO: Need to be enabled from package-group 
IMAGE_INSTALL:append = " phosphor-gpio-monitor"
IMAGE_INSTALL:remove = " ${@bb.utils.contains('IMAGE_FSTYPES', 'intel-pfr', '', 'intel-fw-update', d)}"
IMAGE_INSTALL:append:intel-ast2600 = " ${@bb.utils.contains('IMAGE_FSTYPES', 'intel-pfr', '', ' zram ', d)}"
DISTRO_FEATURES:append = " ldap slp"
IMAGE_FEATURES += "obmc-user-mgmt-ldap"

BBMASK += " ${@bb.utils.contains('MACHINE', 'intel-ast2600','','/meta-core/meta-common/recipes-phosphor/fru/default-fru* ../meta-ami/meta-common/recipes-phosphor/fru/default-fru*', d)}"
BBMASK += " ${@bb.utils.contains('IMAGE_FEATURES', 'onetree-fwupdate', '','recipes-phosphor/flash/cpld-tool.bbappend', d)}"
BBMASK += "meta-openembedded/meta-oe/recipes-extended/ostree/ostree_2024.10.bb"

PRODUCT_GENERATION_TAG = "OneTree"

IMAGE_FEATURES[validitems] += " \
cpld-update \
bios-update \
dual-image \
image-sign  \
sync-conf \
hw-failsafe-boot  \
single-spi-abr  \
"
NON_PFR_UPDATE_FEATURES = ""
#NON_PFR_UPDATE_FEATURES:append = " cpld-update"
NON_PFR_UPDATE_FEATURES:append = " bios-update"
#NON_PFR_UPDATE_FEATURES:append = " dual-image"
#NON_PFR_UPDATE_FEATURES:append = " image-sign"

# NON_PFR_DUAL_FEATURES= " sync-conf"
# NON_PFR_DUAL_FEATURES:append = " hw-failsafe-boot"
# NON_PFR_DUAL_FEATURES= " single-spi-abr"

# EXTRA_IMAGE_FEATURES:append = " ${@bb.utils.contains('IMAGE_FSTYPES', 'intel-pfr', '', NON_PFR_UPDATE_FEATURES , d)}"
# EXTRA_IMAGE_FEATURES:append = " ${@bb.utils.contains('NON_PFR_UPDATE_FEATURES', 'dual-image', NON_PFR_DUAL_FEATURES, '' , d)}"

IMAGE_INSTALL:append = "${@bb.utils.contains('IMAGE_FEATURES', 'onetree-fwupdate', ' cpld-tool ','', d)}"
IMAGE_INSTALL:append = "${@bb.utils.contains('IMAGE_FSTYPES', 'intel-pfr', '', ' system-watchdog ' , d)}"
IMAGE_INSTALL:append = "${@bb.utils.contains('IMAGE_FEATURES', 'onetree-dual-image', ' u-boot-tools ','', d)}"
IMAGE_INSTALL:append = "${@bb.utils.contains('BBFILE_COLLECTIONS', 'intel-features', ' nv-sync ', ' ami-sync ', d)}"

#dm-verity, rootfs verification
#IMAGE_CLASSES += "dm-verity-img"
#DM_VERITY_IMAGE = "obmc-phosphor-image"
#DM_VERITY_IMAGE_TYPE = "squashfs-xz"
#dm-verity

DEFAULT_IMAGE_LINGUAS = ""

#verified boot
#SPL_BINARY = "spl/u-boot-spl.bin"
UBOOT_SIGN_ENABLE = "0"
SPL_SIGN_ENABLE = "0"
UBOOT_FITIMAGE_ENABLE = "0"

FIT_HASH_ALG = "sha256"
FIT_SIGN_ALG = "rsa2048"
FIT_SIGN_NUMBITS = "2048"
UBOOT_FIT_HASH_ALG = "sha256"
UBOOT_FIT_SIGN_ALG = "rsa2048"
UBOOT_FIT_SIGN_NUMBITS = "2048"

UBOOT_SIGN_KEYNAME = "rsa_oem_fitimage_key"
SPL_SIGN_KEYNAME = "rsa_oem_fitimage_key"

UBOOT_SIGN_KEYDIR = "${WORKDIR}"
SPL_SIGN_KEYDIR = "${WORKDIR}"
#verified boot

#Enable Caliptra Secure Boot on AST2700 A1
#OTP_IMAGE_ENABLE = "1"
#OTPTOOL_CONFIGS = "${STAGING_DATADIR_NATIVE}/aspeed-secure-config/ast2700/otp/2700A1_ECDSA384.json"
#OTPTOOL_KEY_DIR = "${STAGING_DATADIR_NATIVE}/aspeed-secure-config/ast2700/keys"
#OTPTOOL_EXTRA_OPTS = "--no_last_bit"
#OTPTOOL_SOC = "2700"
#FMC_IMAGE_ENABLE = "1"
#FMC_SIGN_ENABLE = "1"
#FMC_ECC_KEY_INDEX = "0"
#FMC_ECC_KEY = "${STAGING_DATADIR_NATIVE}/aspeed-secure-config/ast2700/keys/test_oem_dss_private_key_ecdsa384_0.pem"

#OEM Privilege
FEATURE_OEM_PRIV = "1"

#SNMP Trap V3
FEATURE_SNMP_TRAPV3 = "1"

#OpenSSL FIPD
OPENSSL_FIPS_SUPPORT = "enabled"

#NCSI Polling Interval
NCSI_POLLING_INTERVAL = "5"

#USB Port B Function Settings (Default as HOST Controller with Mass Storage, USB Net Adapter(ECM and NCM) and HID Support)
#Note: The HOST Controller and Gadget Device are mutually exclusive, meaning only one function can be active at a time.
#USB_Port_B_Function = "Gadget-Device"

#Enable IPMI BT DRIVER
#IPMI_BT_SUPPORT = "ipmi-bt-enable"

#AMI Core Features to be enabled by default 
IMAGE_FEATURES[validitems] += " \
                        onetree-kvm \
                        onetree-media-redirect \
                        onetree-jviewer \
                        onetree-webui \
                        onetree-sensors \                       
                        onetree-power \
                        onetree-phosphor-power \
                        onetree-gpio-presence \
                        onetree-fru \
                        onetree-sel \
                        onetree-postcode \
                        onetree-pef-alert \
                        onetree-snmp \
                        onetree-smtp \
                        onetree-sol \
                        onetree-session \
                        onetree-ipmi \
                        onetree-radius-client \
                        onetree-license \
                        onetree-backup-restore \
                        onetree-dbus \
                        onetree-host-error \
                        onetree-certificate_mgnt \
                        onetree-critical_process \
                        onetree-thermal-mgnt \
                        onetree-ntp \
                        onetree-slpd \
                        onetree-lldpd \
                        onetree-boot_override \
                        onetree-bootlogo \
                        onetree-2fa \
                        onetree-prov-mode-mgr \
                        onetree-rbc-mgr \
			onetree-nic \
                        onetree-nvme \
                        onetree-nvmebasic \
                        onetree-rtp \
                        onetree-brcmpciesw \
                        onetree-brcmraid \
                        onetree-brcmraid8 \
                        onetree-msccraid \
			onetree-intel-pfr \
                        onetree-asd \
                        onetree-gpgpu \
                        onetree-amdremotedbg \
                        onetree-mrt \
			onetree-acd \
			onetree-intelsipack \
			onetree-intel-mctp \
			onetree-intel-pldm \
			onetree-spdm \
			onetree-network \
			onetree-network-system-firewall-support \
			onetree-network-advanced-route-support \
			onetree-network-bonding-support \
			onetree-network-openssl-support \
			onetree-network-disable-ping-support \
			onetree-network-iperf3-support \
			onetree-network-ncsi-support \
			onetree-network-ncsi-manual-detect-support \
                        onetree-fwupdate \
                        onetree-fwupdate-cpld-update \
                        onetree-image-sign \
                        onetree-dual-image \
                        onetree-dual-image-common-conf \
                        onetree-hw-failsafe-boot \
                        onetree-single-spi-abr \
                        onetree-sync-conf \
			onetree-tools \
                        onetree-host-interface \
                        onetree-network-phy-configuration-support \
                        onetree-network-tsig-support \
                        onetree-network-nsupdate-support \
                        onetree-network-persist-mac-support \
                        onetree-network-avahi-support \
                        onetree-network-doh-support \
                        onetree-bios-update \
                        onetree-extlog \
                        onetree-phosphor-ipmi-flash \
                        onetree-pldm \
                        onetree-bmc-services-ready \
			onetree-power-restore-policy \
                        onetree-pdk \
                        onetree-cxl-mgmt \
			onetree-network-ncsi-non-aen-support \
			onetree-network-ncsi-channel-timer \
			onetree-network-ncsi-async-reset-support \
			onetree-multi-host-support \
			onetree-telemetry \
                        onetree-psm \
                        onetree-rpc \
			onetree-rm \
			onetree-cxl-mgmt \
			onetree-phosphor-health-monitor \
                        onetree-mac-eeprom-support \
			"

LF_CORE_FEATURES = " \
                        obmc-bmc-state-mgmt \
                        obmc-bmcweb \
                        obmc-chassis-mgmt \
                        obmc-devtools \
                        obmc-fan-control \
                        obmc-fan-mgmt \
                        obmc-flash-mgmt \
                        obmc-host-ctl \
                        obmc-host-ipmi \
                        obmc-chassis-state-mgmt \
                        obmc-host-state-mgmt \
                        obmc-inventory \
                        obmc-leds \
                        obmc-logging-mgmt \
                        obmc-remote-logging-mgmt \
                        obmc-net-ipmi \
                        obmc-sensors \
                        obmc-software \
                        obmc-system-mgmt \
                        obmc-user-mgmt \
                        obmc-user-mgmt-ldap \
                        ssh-server-dropbear \
                        obmc-debug-collector \
                        obmc-network-mgmt \
                        obmc-settings-mgmt \
                        onetree-phosphor-health-monitor \
			"

AMI_CORE_FEATURES = " \
			debug-tweaks \
			onetree-kvm \
			onetree-media-redirect \
			onetree-jviewer \
                        onetree-webui \
                        onetree-sensors \
			onetree-power \
			onetree-phosphor-power \
			onetree-gpio-presence \
                        onetree-fru \
			onetree-sel \
			onetree-postcode \
                        onetree-pef-alert \
			onetree-snmp \
			onetree-smtp \
                        onetree-radius-client \
			onetree-sol \
			onetree-session \
			onetree-license \
			onetree-backup-restore \
			onetree-host-error \
			onetree-thermal-mgnt \
			onetree-ntp \
			onetree-slpd \
			onetree-lldpd \
                        onetree-2fa \
			onetree-prov-mode-mgr \
			onetree-rbc-mgr \
			onetree-network \
			onetree-network-system-firewall-support \
			onetree-network-advanced-route-support \
			onetree-network-openssl-support \
			onetree-network-disable-ping-support \
			onetree-tools \
			onetree-host-interface \
			onetree-network-phy-configuration-support \
			onetree-network-nsupdate-support \
			onetree-network-persist-mac-support \
			onetree-network-tsig-support \
			onetree-network-avahi-support \
                        onetree-network-doh-support \
			onetree-bios-update \
                        onetree-extlog \
                        onetree-phosphor-ipmi-flash \
                        onetree-bmc-services-ready \
			onetree-power-restore-policy \
                        onetree-pdk \
                        onetree-telemetry \
                        onetree-phosphor-health-monitor \
			"

EXTRA_IMAGE_FEATURES:append = " ${LF_CORE_FEATURES} ${AMI_CORE_FEATURES} "
EXTRA_IMAGE_FEATURES:remove = " ${@ 'onetree-network-tsig-support' if 'onetree-network-nsupdate-support' not in d.getVar('AMI_CORE_FEATURES', False) else ''}"

PREFERRED_VERSION_binutils = "2.46"
IMAGE_INSTALL:append = " ${@bb.utils.contains('EXTRA_IMAGE_FEATURES', 'onetree-network-doh-support', 'https-dns-proxy','', d)} "

STATIC_SENSOR_NUMBER_ENABLE ??= "0"

#
# TODO: enable this to have mac eeprom support
#
# EXTRA_IMAGE_FEATURES:append = " onetree-mac-eeprom-support "
```

## meta-ami-devkit/conf/layer.conf
```bitbake
BBPATH .= ":${LAYERDIR}"

BBFILES += "${LAYERDIR}/recipes-*/*/*.bb \
            ${LAYERDIR}/recipes-*/*/*.bbappend \
            ${LAYERDIR}/recipes-*/*/*/*.bb \
            ${LAYERDIR}/recipes-*/*/*/*.bbappend \
           "

BBFILE_COLLECTIONS += "meta-ami-devkit"
BBFILE_PATTERN_meta-ami-devkit = "^${LAYERDIR}/"
BBFILE_PRIORITY_meta-ami-devkit = "20"

LAYERVERSION_meta-ami-devkit = "1"
LAYERSERIES_COMPAT_meta-ami-devkit = "walnascar"
LAYERDEPENDS_meta-ami-devkit = "meta-ami evb evb-aspeed evb-ast2600"
```

## meta-amidevkit-2700/conf/layer.conf
```bitbake
BBPATH .= ":${LAYERDIR}"
BBFILES += "${LAYERDIR}/recipes-*/*/*.bb ${LAYERDIR}/recipes-*/*/*.bbappend"

BBFILE_COLLECTIONS += "amidevkit-2700"
BBFILE_PATTERN_amidevkit-2700 := "^${LAYERDIR}/"
BBFILE_PRIORITY_amidevkit-2700 = "20"
LAYERSERIES_COMPAT_amidevkit-2700 = "walnascar"
LAYERDEPENDS_amidevkit-2700 = "meta-ami aspeed-sdk-layer ast2700-sdk-layer"
```

## meta-amidevkit-2700/conf/machine/devkit2700.conf
```bitbake
MACHINEOVERRIDES =. "ast2700-default:"
require conf/machine/ast2700-default.conf
```

## meta-aminuvton/conf/layer.conf
```bitbake
BBPATH .= ":${LAYERDIR}"
BBFILES += "${LAYERDIR}/recipes-*/*/*.bb \
			${LAYERDIR}/recipes-*/*/*.bbappend \
			${LAYERDIR}/recipes-*/*/*/*.bb \
			${LAYERDIR}/recipes-*/*/*/*.bbappend"

BBFILE_COLLECTIONS += "meta-aminuvton"
BBFILE_PATTERN_meta-aminuvton := "^${LAYERDIR}/"
BBFILE_PRIORITY_meta-aminuvton = "21"
LAYERSERIES_COMPAT_meta-aminuvton = "walnascar"
LAYERDEPENDS_meta-aminuvton = "meta-ami evb-npcm845"
```

## meta-evb/meta-evb-arm/meta-evb-fvp-base/conf/layer.conf
```bitbake
BBPATH .= ":${LAYERDIR}"

BBFILES += "\
${LAYERDIR}/recipes-*/*/*.bb \
${LAYERDIR}/recipes-*/*/*.bbappend \
"

BBFILE_COLLECTIONS += "evb-fvp-base"
BBFILE_PATTERN_evb-fvp-base = "^${LAYERDIR}/"
BBFILE_PRIORITY_evb-fvp-base = "15"
LAYERSERIES_COMPAT_evb-fvp-base = "walnascar"

#Disable Multi-SOL
MULTI_SOL_ENABLED = "0"

EXTRA_IMAGE_FEATURES:remove = "\
    onetree-kvm \
    onetree-media-redirect \
    onetree-jviewer \
    onetree-2fa \
    onetree-fru \
    onetree-host-interface \
"

LF_CORE_FEATURES:append ?= " obmc-dmtf-pmci obmc-telemetry"
IMAGE_INSTALL:remove = " hw-watchdog "
```

## meta-evb/meta-evb-aspeed/conf/layer.conf
```bitbake
# We have a conf and classes directory, add to BBPATH
BBPATH .= ":${LAYERDIR}"

BBFILE_COLLECTIONS += "evb-aspeed"
BBFILE_PATTERN_evb-aspeed = ""

LAYERSERIES_COMPAT_evb-aspeed = "walnascar"
IMAGE_INSTALL:append = "${@bb.utils.contains('IMAGE_FEATURES', 'onetree-fwupdate', ' nv-sync ','', d)}"
IMAGE_INSTALL:remove = "${@bb.utils.contains('IMAGE_FEATURES', 'onetree-dual-image-common-conf', ' nv-sync ','', d)}"

BBMASK += '${@bb.utils.contains("BBFILE_COLLECTIONS", "restricted", "/meta-core/meta-restricted/recipes-intel/images/intel-platforms.bbappend", "",d)}'
EXTRA_IMAGE_FEATURES:remove = '${@bb.utils.contains("BBFILE_COLLECTIONS", "restricted", "    onetree-acd \
    onetree-mrt \
    onetree-intelsipack ", "",d)}'

EXTRA_IMAGE_FEATURES:remove = '${@bb.utils.contains("BBFILE_COLLECTIONS", "restricted", "  \
	oob-config-features \
	seamless-featurs \
	testability-features ", "",d)}'
```
