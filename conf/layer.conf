## meta-evb/meta-evb-aspeed/meta-evb-ast2600/conf/layer.conf
```bitbake
LOCALCONF_VERSION = "4"
# We have a conf and classes directory, add to BBPATH
BBPATH .= ":${LAYERDIR}"

# We have recipes-* directories, add to BBFILES
BBFILES += "${LAYERDIR}/recipes-*/*/*.bb \
            ${LAYERDIR}/recipes-*/*/*.bbappend"

BBFILE_COLLECTIONS += "evb-ast2600"
BBFILE_PATTERN_evb-ast2600 = "^${LAYERDIR}/"
BBFILE_PRIORITY_evb-ast2600 = "11"
LAYERSERIES_COMPAT_evb-ast2600 = "walnascar"

# uncomment below 2 lines to enable SW eMMC support
#EXTRA_IMAGE_FEATURES:append = " emmc-sw-ami "
#IMAGE_FSTYPES += "wic.xz mmc-ext4-tar"
#bootlogo

EXTRA_IMAGE_FEATURES:append = " onetree-bootlogo"

EXTRA_IMAGE_FEATURES:append = " onetree-bmc-auto-recovery "
IMAGE_FEATURES[validitems] += "onetree-bmc-auto-recovery"
IMAGE_INSTALL:append = "${@bb.utils.contains('IMAGE_FEATURES', 'onetree-bmc-auto-recovery', ' bmc-auto-recovery ', '', d)}"

# SW eMMC support - configs start
IMAGE_FEATURES[validitems] += "emmc-sw-ami"
OVERRIDES:append = "${@bb.utils.contains('EXTRA_IMAGE_FEATURES', 'emmc-sw-ami', ':emmc-sw-ami:df-phosphor-mmc:ast-mmc', '', d)}"

DISTRO_FEATURES += "${@bb.utils.contains('EXTRA_IMAGE_FEATURES', 'emmc-sw-ami', 'phosphor-mmc', '', d)}"
MACHINE_FEATURES += "${@bb.utils.contains('EXTRA_IMAGE_FEATURES', 'emmc-sw-ami', 'ast-mmc', '', d)}"

WKS_FILE = "emmc-ami.wks.in"

IMAGE_OVERHEAD_FACTOR:emmc-sw-ami = "1.0"
IMAGE_ROOTFS_EXTRA_SPACE:emmc-sw-ami = "4096"
BAD_RECOMMENDATIONS:remove = "${@bb.utils.contains('EXTRA_IMAGE_FEATURES', 'emmc-sw-ami', 'e2fsprogs-e2fsck', '', d)}"
# SW eMMC support - configs end

IMAGE_INSTALL:append = "${@bb.utils.contains('ENABLE_COMMUNITY_MCTP_KERNEL_MODE', '1', ' mctp mctp-ext', '', d)}"

PRODUCT_GENERATION = "OT"
```

## meta-evb/meta-evb-aspeed/meta-evb-ast2600/conf/machine/include/evb-ast2600-layout.inc
```bitbake
# All sizes & offsets below are in KB
#flash-size
FLASH_SIZE = "65536"

#SectionName: "u-boot"
FLASH_UBOOT_OFFSET:flash-65536 = "0" 
FLASH_UBOOT_SIZE:flash-65536 = "896"

#SectionName: "u-boot-env"
FLASH_UBOOT_ENV_OFFSET:flash-65536 = "896" 
FLASH_UBOOT_ENV_SIZE:flash-65536 = "128"

#SectionName: "kernel"
FLASH_KERNEL_OFFSET:flash-65536 = "1024" 
FLASH_KERNEL_SIZE:flash-65536 = "14336"

#SectionName: "rofs"
FLASH_ROFS_OFFSET:flash-65536 = "15360" 
FLASH_ROFS_SIZE:flash-65536 = "41984"

#SectionName: "rwfs"
FLASH_RWFS_OFFSET:flash-65536 = "57344" 
FLASH_RWFS_SIZE:flash-65536 = "8128"

#SectionName: "reserved"
FLASH_RESERVED_OFFSET:flash-65536 = "65472" 
FLASH_RESERVED_SIZE:flash-65536 = "64"
```

## meta-evb/meta-evb-aspeed/meta-evb-ast2700/conf/layer.conf
```bitbake
# We have a conf and classes directory, add to BBPATH
BBPATH .= ":${LAYERDIR}"

BBFILES += "${LAYERDIR}/recipes-*/*/*.bb \
            ${LAYERDIR}/recipes-*/*/*.bbappend"

BBMASK += "meta-core/meta-restricted/recipes-intel/images/intel-platforms.bbappend"
BBMASK += "meta-core/meta-intel/recipes-intel/images/intel-platforms.bbappend"
BBMASK += "meta-core/meta-restricted/recipes-optee"
BBMASK += "meta-ami/meta-evb/meta-evb-aspeed/meta-evb-ast2700/recipes-phosphor/pmci/libmctp-intel_git.bb"

BBFILE_COLLECTIONS += "aspeed-sdk-layer"
BBFILE_PATTERN_aspeed-sdk-layer := "^${LAYERDIR}/"
LAYERVERSION_aspeed-sdk-layer = "1"
BBFILE_PRIORITY_aspeed-sdk-layer = "11"
LAYERSERIES_COMPAT_aspeed-sdk-layer = "walnascar"

# Provide a variable that points the base of the aspeed-sdk layer.
ASPEEDSDKBASE = '${@os.path.normpath("${LAYERDIR}/")}'

BBFILES_DYNAMIC += " \
    meta-arm:${LAYERDIR}/dynamic-layers/arm-layer/recipes-*/*/*.bb \
    meta-arm:${LAYERDIR}/dynamic-layers/arm-layer/recipes-*/*/*.bbappend \
    zephyrcore:${LAYERDIR}/dynamic-layers/zephyrcore-layer/recipes-*/*/*.bb \
    zephyrcore:${LAYERDIR}/dynamic-layers/zephyrcore-layer/recipes-*/*/*.bbappend \
"

# IMAGE_INSTALL:append = " ami-sync "
ENABLE_BONDING = "${@bb.utils.contains('EXTRA_IMAGE_FEATURES', 'onetree-network-bonding-support', 'network-bond', '', d)}"

# Remove community mctp by default; set ENABLE_COMMUNITY_MCTP_KERNEL_MODE = '1' to use it
RDEPENDS:packagegroup-oss-apps:remove = "${@bb.utils.contains('ENABLE_COMMUNITY_MCTP_KERNEL_MODE', '1', '', 'mctp', d)}"
BBMASK += "${@bb.utils.contains('ENABLE_COMMUNITY_MCTP_KERNEL_MODE', '1', ' meta-ami/meta-evb/meta-evb-aspeed/meta-evb-ast2700/recipes-phosphor/libmctp/libmctp_%.bbappend meta-ami/meta-common/recipes-phosphor/libmctp/libmctp_%.bbappend', '', d)}"
IMAGE_INSTALL:append = "${@bb.utils.contains('ENABLE_COMMUNITY_MCTP_KERNEL_MODE', '1', ' mctp mctp-ext', '', d)}"
```

## meta-evb/meta-evb-aspeed/meta-evb-ast2700/conf/machine/include/ast-arm-trusted-firmware-a.inc
```bitbake
MACHINE_FEATURES:append = " ast-arm-trusted-firmware-a"
MACHINEOVERRIDES .= ":ast-arm-trusted-firmware-a"
UBOOT_FIT_ARM_TRUSTED_FIRMWARE = "1"

PREFERRED_PROVIDER_virtual/bootloader = "u-boot-onetree"
PREFERRED_PROVIDER_u-boot = "u-boot-onetree"
PREFERRED_PROVIDER_u-boot-fw-utils = "u-boot-fw-utils-onetree"

PREFERRED_VERSION_u-boot-onetree = "v2023.10+%"
PREFERRED_VERSION_u-boot-fw-utils-onetree = "v2023.10+%"
```

## meta-evb/meta-evb-aspeed/meta-evb-ast2700/conf/machine/include/ast-ibexfw.inc
```bitbake
MACHINE_FEATURES:append = " ast-ibexfw"
MACHINEOVERRIDES .= ":ast-ibexfw"
UBOOT_FIT_CONF_FIRMWARE = "ibexfw"

PREFERRED_PROVIDER_virtual/bootloader = "u-boot-onetree"
PREFERRED_PROVIDER_u-boot = "u-boot-onetree"
PREFERRED_PROVIDER_u-boot-fw-utils = "u-boot-fw-utils-onetree"

PREFERRED_VERSION_u-boot-onetree = "v2023.10+%"
PREFERRED_VERSION_u-boot-fw-utils-onetree = "v2023.10+%"
```

## meta-evb/meta-evb-aspeed/meta-evb-ast2700/conf/machine/include/ast-ssp.inc
```bitbake
MACHINE_FEATURES:append = " ast-ssp"
MACHINEOVERRIDES .= ":ast-ssp"

# AST2600
# Do not load the "aspeed-ssp" module on boot.
KERNEL_MODULE_PROBECONF:append:aspeed-g6 = " aspeed-ssp"
module_conf_aspeed-ssp = "blacklist aspeed-ssp"

# AST2700
UBOOT_FIT_CONF_USER_LOADABLES:append:aspeed-g7 = ' ,\"sspfw\"'
PREFERRED_PROVIDER_virtual/bootloader = "u-boot-onetree"
PREFERRED_PROVIDER_u-boot = "u-boot-onetree"
PREFERRED_PROVIDER_u-boot-fw-utils = "u-boot-fw-utils-onetree"

PREFERRED_VERSION_u-boot-onetree = "v2023.10+%"
PREFERRED_VERSION_u-boot-fw-utils-onetree = "v2023.10+%"
```

## meta-evb/meta-evb-aspeed/meta-evb-ast2700/conf/machine/include/ast2700-a1.inc
```bitbake
MACHINE_FEATURES:append = " ast2700-a1"
MACHINEOVERRIDES .= ":ast2700-a1"
PREFERRED_PROVIDER_virtual/bootloader = "u-boot-onetree"
PREFERRED_PROVIDER_u-boot = "u-boot-onetree"
PREFERRED_PROVIDER_u-boot-fw-utils = "u-boot-fw-utils-onetree"

PREFERRED_VERSION_u-boot-onetree = "v2023.10+%"
PREFERRED_VERSION_u-boot-fw-utils-onetree = "v2023.10+%"
```

## meta-evb/meta-evb-aspeed/meta-evb-ast2700/conf/machine/include/spi-nor-ecc.inc
```bitbake
# Support SPI NOR ECC Flash.

MACHINE_FEATURES:append = " spi-nor-ecc "
MACHINEOVERRIDES .= ":spi-nor-ecc"

PREFERRED_PROVIDER_virtual/bootloader = "u-boot-onetree"
PREFERRED_PROVIDER_u-boot = "u-boot-onetree"
PREFERRED_PROVIDER_u-boot-fw-utils = "u-boot-fw-utils-onetree"

PREFERRED_VERSION_u-boot-onetree = "v2023.10+%"
PREFERRED_VERSION_u-boot-fw-utils-onetree = "v2023.10+%"
```
